## Kconfig
```kconfig
menuconfig LIB_SNMP
	bool "Enable the SNMP library"
	default n
	help
	  Library routines for SNMP

if LIB_SNMP

module = LIB_SNMP
module-str = LIB_SNMP
source "subsys/logging/Kconfig.template.log_config"

config SNMP_STACK_SIZE
	int "SNMP stack size"
	default 4096
	help
		The stack size for the SNMP thread.

config SNMP_THREAD_PRIORITY
	int "SNMP thread priority"
	default 8
	help
		The priority of the SNMP thread.

endif #LIB_SNMP
```
